## drivers/expose-hypcalls/Kconfig
```kconfig
# SPDX-License-Identifier: GPL-2.0

config EXPOSE_HYPCALLS
	tristate "EXPOSE_HYPCALLS"
	help
	  Expose device_attach, device_detach ioctls to guest userspace.
```

## drivers/io-mem/Kconfig
```kconfig
# SPDX-License-Identifier: GPL-2.0

config IO_MEM
	tristate "IO_MEM"
	help
	  I/O memory shared between host and guest. Could be used to share
	  inference input and output.
```
